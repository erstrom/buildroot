## configs/qemu_ath10k_x86_64_defconfig
```kconfig
BR2_x86_64=y
BR2_TOOLCHAIN_BUILDROOT_GLIBC=y
BR2_TARGET_GENERIC_GETTY_PORT="tty1"
BR2_ENABLE_LOCALE_WHITELIST="C en_US sv_SE"
BR2_LINUX_KERNEL=y
BR2_LINUX_KERNEL_CUSTOM_GIT=y
BR2_LINUX_KERNEL_CUSTOM_REPO_URL="https://github.com/erstrom/linux-ath.git"
BR2_LINUX_KERNEL_CUSTOM_REPO_VERSION="ath-201705171256-ath10k-high-latency"
BR2_LINUX_KERNEL_USE_CUSTOM_CONFIG=y
BR2_LINUX_KERNEL_CUSTOM_CONFIG_FILE="board/qemu/x86_64/linux_ath10k_defconfig"
BR2_PACKAGE_ATH10K_FIRMWARE=y
BR2_PACKAGE_ATH10K_FIRMWARE_GIT_URL="https://github.com/erstrom/ath10k-firmware.git"
BR2_PACKAGE_ATH10K_FIRMWARE_GIT_REV="usb-old"
BR2_PACKAGE_IW=y
BR2_TARGET_ROOTFS_CPIO=y
BR2_TARGET_ROOTFS_CPIO_GZIP=y
# BR2_TARGET_ROOTFS_TAR is not set
BR2_PACKAGE_HOST_MKE2IMG=y
```

## package/ath10k-firmware/Config.in
```kconfig
config BR2_PACKAGE_ATH10K_FIRMWARE
	bool "ath10k-firmware"
	help
	  Firmware for the Qualcomm Atheros 802.11ac Wifi devices supported
	  by the ath10k kernel driver.

if BR2_PACKAGE_ATH10K_FIRMWARE

config BR2_PACKAGE_ATH10K_FIRMWARE_GIT_URL
        string "GIT URL"
        default "https://github.com/kvalo/ath10k-firmware.git"

config BR2_PACKAGE_ATH10K_FIRMWARE_GIT_REV
        string "GIT REV"
        default "master"

endif
```
